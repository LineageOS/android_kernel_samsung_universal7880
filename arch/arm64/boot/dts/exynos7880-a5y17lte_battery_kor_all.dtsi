/*
 * SAMSUNG UNIVERSAL7880 board device tree source
 *
 * Copyright (c) 2016 Samsung Electronics Co., Ltd.
 *		http://www.samsung.com
 *
 * This program is free software; you can redistribute it and/or modify
 * it under the terms of the GNU General Public License version 2 as
 * published by the Free Software Foundation.
*/
#include "exynos7880-a5y17lte-common-battery.dtsi"

/ {
	battery_params {
			battery,battery_data = 
				<
				/***** battery data for 4.35 *****/
				/* battery,battery_table3 */
				204 11 61 11 175 10 34 10 169 9
				55 9 206 8 107 8 230 7 166 7
				77 7 234 6 174 6 130 6 95 6
				67 6 36 6 253 5 197 5 147 5
				42 5 168 1 247 8 136 8 24 8
				169 7 58 7 202 6 91 6 236 5
				124 5 13 5 158 4 47 4 191 3
				80 3 225 2 113 2 2 2 147 1
				36 1 180 0 69 0 214 15

				/* battery,battery_table4 */
				62 62 61 60 61 60 59 60 60 58
				58 58 58 58 58 58 59 60 62 64
				76 154

				/* battery,batcap */
				0xE0 0x2E 0xB8 0x0B /* [0x0E] [0x0F] [0x10] [0x11] */
				/* battery,accum */ 
				0x8 0x00 /* [0x45] [0x44] */

				/* battery,soc_arr_val */
				11205 10662 10119 9575 9032 8488 7945 7402 6858 6315 5771 5228 4685 4141 3598 3054 2511 1968 1424 881 337 (-206)
				/* battery,ocv_arr_val */
				44747 44050 43353 42664 42077 41520 41006 40522 39872 39562 39127 38645 38349 38135 37966 37828 37676 37485 37211 36970 36454 32069


				/***** battery data for 4.33 *****/
				/* battery,battery_table3 */
				80 11 211 10 85 10 216 9 99 9
				244 8 141 8 41 8 212 7 133 7
				22 7 207 6 158 6 120 6 89 6
				63 6 29 6 243 5 196 5 136 5 
				105 5 199 2 219 8 110 8 0 8
				146 7 37 7 183 6 73 6 220 5
				110 5 0 5 147 4 37 4 183 3 
				74 3 220 2 111 2 1 2 147 1
				38 1 184 0 74 0 221 15

				/* battery,battery_table4 */
				53 53 52 52 52 53 53 53 52 52
				53 53 54 54 53 54 54 55 56 61
				75 133

				/* battery,batcap */
				0x10 0x2C 0x04 0x0B /* [0x0E] [0x0F] [0x10] [0x11] */
				/* battery,accum */
				0x8 0x00 /* [0x45] [0x44] */

				/* battery,soc_arr_val */
				11070 10535 10000 9465 8929 8394 7859 7323 6788 6252 5717 5182 4646 4111 3576 3040 2505 1970 1434 898 363 (-173)
				/* battery,ocv_arr_val */
				44143 43530 42917 42304 41734 41194 40687 40199 39787 39399 38859 38509 38272 38085 37936 37808 37642 37439 37205 36913 36763 33474
		
				/***** battery data for 4.31 *****/
				/* battery,battery_table3 */
				40 11 172 10 48 10 181 9 66 9
				213 8 114 8 14 8 190 7 105 7
				252 6 191 6 146 6 110 6 81 6
				56 6 17 6 234 5 177 5 133 5
				9 5 92 1 223 8 112 8 0 8
				144 7 33 7 177 6 65 6 210 5
				98 5 242 4 131 4 19 4 163 3
				52 3 196 2 84 2 229 1 117 1
				5 1 149 0 38 0 201 15

				/* battery,battery_table4 */
				51 51 51 51 51 52 52 52 53 52
				52 53 53 54 54 55 55 56 56 58
				62 151

				/* battery,batcap */                                  
				0x48 0x2B 0xD2 0x0A /* [0x0E] [0x0F] [0x10] [0x11] */ 
				/* battery,accum */
				0x8 0x00 /* [0x45] [0x44] */

				/* battery,soc_arr_val */
				11090 10545 10000 9455 8909 8364 7819 7274 6728 6183 5638 5092 4547 4002 3457 2911 2366 1821 1275 730 185 (-270)
				/* battery,ocv_arr_val */
				43944 43340 42736 42132 41573 41042 40556 40069 39680 39264 38730 38431 38211 38036 37896 37774 37582 37392 37114 36900 36295 31701

				/***** battery data for 4.29 *****/
				/* battery,battery_table3 */
				254 10 132 10 10 10 144 9 30 9
				179 8 81 8 243 7 166 7 67 7
				230 6 176 6 134 6 101 6 74 6
				46 6 4 6 219 5 153 5 130 5
				97 4 70 1 226 8 113 8 0 8
				143 7 30 7 173 6 60 6 203 5
				90 5 233 4 120 4 7 4 150 3
				37 3 180 2 67 2 211 1 97 1
				240 0 127 0 14 0 210 15

				/* battery,battery_table4 */
				52 52 52 51 51 52 52 52 53 52
				52 52 53 54 54 55 55 56 57 60
				68 135

				/* battery,batcap */                                  
				0xA8 0x2A 0xAA 0x0A /* [0x0E] [0x0F] [0x10] [0x11] */ 
				/* battery,accum */
				0x8 0x00 /* [0x45] [0x44] */

				/* battery,soc_arr_val */
				11104 10552 10000 9448 8897 8345 7794 7242 6690 6139 5587 5036 4484 3932 3381 2829 2278 1726 1174 622 70 (-224)

				/* battery,ocv_arr_val */
				43742 43145 42548 41951 41397 40875 40395 39938 39560 39077 38622 38358 38154 37991 37861 37724 37518 37319 36996 36884 35474 31590	

				/***** battery data for 4.24 *****/
				/* batterybattery_table3 */
				9 11 147 10 29 10 167 9 50 9
				196 8 97 8 0 8 177 7 88 7
				240 6 183 6 140 6 105 6 78 6
				51 6 9 6 227 5 165 5 132 5
				183 4 67 1 100 9 238 8 119 8
				0 8 137 7 19 7 156 6 37 6
				174 5 56 5 193 4 74 4 212 3
				93 3 230 2 111 2 249 1 130 1
				11 1 148 0 30 0 206 15

				/* batterybattery_table4 */
				51 51 51 51 51 51 52 52 52 52
				52 52 53 54 54 55 55 56 57 60
				66 154

				/* batterybatcap */                                  
				0xA0 0x28 0x28 0x0A/* [0x0E] [0x0F] [0x10] [0x11] */ 
				/* batteryaccum */
				0x8 0x00 /* [0x45] [0x44] */

				/* batterysoc_arr_val */
				11740 11160 10580 10000 9420 8841 8261 7681 7101 6522 5942 5362 4783 4203 3623 3043 2464 1884 1304 725 145 (-245)

				/* batteryocv_arr_val */
				43793 43218 42643 42068 41493 40958 40475 40001 39614 39178 38671 38394 38182 38014 37881 37750 37546 37358 37056 36896 35892 31579
				>;

			battery,battery_table3 = <204 11 61 11 175 10 34 10 170 9
						55 9 206 8 107 8 230 7 166 7
						77 7 235 6 174 6 130 6 95 6
						67 6 36 6 253 5 197 5 147 5
						42 5 168 1 245 8 135 8 24 8
						170 7 59 7 205 6 94 6 240 5
						129 5 18 5 164 4 53 4 199 3
						88 3 234 2 123 2 13 2 158 1
						48 1 193 0 83 0 228 15>;

			battery,battery_table4 = <62 62 61 60 61 60 59 60 60 58
						58 58 58 58 58 58 59 60 62 64
						76 154>;

			battery,batcap = <0xE0 0x2E 0xB8 0x0B>; /* [0x0E] [0x0F] [0x10] [0x11] */
			battery,accum = <0x8 0x00>; /* [0x45] [0x44] */

			battery,soc_arr_val = <11198 10658 10118 9579 9039 8499 7960 7420 6880 6340 5801 5261 4721 4182 3642 3102 2562 2023 1483 943 404 (-136)>;
			battery,ocv_arr_val = <44746 44050 43354 42665 42078 41520 41006 40523 39872 39563 39127 38646 38349 38135 37966 37828 37676 37485 37211 36970 36453 32069>;
	};
};
